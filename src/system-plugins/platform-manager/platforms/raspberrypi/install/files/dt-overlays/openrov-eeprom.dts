// OpenROV EEPROM Overlay
/dts-v1/;
/plugin/;

/ {
        compatible = "brcm,bcm2708", "brcm,bcm2709";

        fragment@0 {
                target = <&i2c1>;
                __overlay__ {
                        #address-cells = <1>;
                        #size-cells = <0>;
                        status = "okay";

                        eeprom: eeprom@54 {
                                compatible = "at,24c256";
                                reg = <0x54>;
                                pagesize = <32>;
                        };

                };
        };
};
